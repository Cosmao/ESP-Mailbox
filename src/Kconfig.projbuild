## src/Kconfig.projbuild
```kconfig
menu "Wifi and MQTT config"

    menu "Wifi config"

      config ESP_WIFI_SSID
          string "WiFi SSID"
          default "myssid"
          help
              SSID (network name) for the example to connect to.

      config ESP_WIFI_PASSWORD
          string "WiFi Password"
          default "mypassword"
          help
              WiFi password (WPA or WPA2) for the example to use.

      choice ESP_WIFI_SAE_MODE
          prompt "WPA3 SAE mode selection"
          default ESP_WPA3_SAE_PWE_BOTH
          help
              Select mode for SAE as Hunt and Peck, H2E or both.
          config ESP_WPA3_SAE_PWE_HUNT_AND_PECK
              bool "HUNT AND PECK"
          config ESP_WPA3_SAE_PWE_HASH_TO_ELEMENT
              bool "H2E"
          config ESP_WPA3_SAE_PWE_BOTH
              bool "BOTH"
      endchoice

      config ESP_WIFI_PW_ID
          string "PASSWORD IDENTIFIER"
          depends on  ESP_WPA3_SAE_PWE_HASH_TO_ELEMENT|| ESP_WPA3_SAE_PWE_BOTH
          default ""
          help
              password identifier for SAE H2E

      config ESP_MAXIMUM_RETRY
          int "Maximum retry"
          default 5
          help
              Set the Maximum retry to avoid station reconnecting to the AP unlimited when the AP is really inexistent.

      choice ESP_WIFI_SCAN_AUTH_MODE_THRESHOLD
          prompt "WiFi Scan auth mode threshold"
          default ESP_WIFI_AUTH_WPA2_PSK
          help
              The weakest authmode to accept in the scan mode.
              This value defaults to ESP_WIFI_AUTH_WPA2_PSK incase password is present and ESP_WIFI_AUTH_OPEN is used.
              Please select ESP_WIFI_AUTH_WEP/ESP_WIFI_AUTH_WPA_PSK incase AP is operating in WEP/WPA mode.

          config ESP_WIFI_AUTH_OPEN
              bool "OPEN"
          config ESP_WIFI_AUTH_WEP
              bool "WEP"
          config ESP_WIFI_AUTH_WPA_PSK
              bool "WPA PSK"
          config ESP_WIFI_AUTH_WPA2_PSK
              bool "WPA2 PSK"
          config ESP_WIFI_AUTH_WPA_WPA2_PSK
              bool "WPA/WPA2 PSK"
          config ESP_WIFI_AUTH_WPA3_PSK
              bool "WPA3 PSK"
          config ESP_WIFI_AUTH_WPA2_WPA3_PSK
              bool "WPA2/WPA3 PSK"
          config ESP_WIFI_AUTH_WAPI_PSK
              bool "WAPI PSK"
      endchoice

    endmenu

    config ESP_RTC_WAKEUP_PIN
      int "RTC Wakeup pin"
      default 7
      help
        What pin to wakeup on

    config ESP_RTC_TIMEOUT_SEC
      int "RTC timeout in seconds"
      default 30
      help
        How many seconds to wait on a reed wake before a timeout is triggered and we go back to sleep

    config ESP_WAKEUP_TIME_IN_HOURS
      int "RTC Wakeup time in hours"
      default 5
      help
        How many hours between the ESP waking itself to check into the mqtt server to make sure the battery and connection is still good

    config ESP_MQTT_TOPIC
      string "Mqtt topic to use"
      default "letterbox/"
      help
        What topic its supposed to send messages to

    config ESP_MQTT_ENDPOINT
      string "Mqtt endpoint"
      help
        The endpoint that mqtt is going to use

endmenu
```
